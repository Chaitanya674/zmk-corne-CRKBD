/*
 * OLED panel override for Corne (shared by left + right).
 *
 * WHY THIS FILE EXISTS
 * --------------------
 * ZMK's stock corne.dtsi hard-codes the display as a 128x32 SSD1306 with
 * `inversion-on`. If the panel you soldered on is not exactly that part,
 * you get garbage: wrong geometry leaves most of the panel untouched, and
 * `inversion-on` means "untouched" renders as LIT, not dark. That is the
 * all-blue screen.
 *
 * Pick ONE of the three blocks below. Leave the others commented out.
 */

/* ------------------------------------------------------------------ */
/* OPTION A - 0.91" 128x32 SSD1306  (the classic Corne OLED)          */
/* ------------------------------------------------------------------ */
&oled {
    compatible = "solomon,ssd1306fb";
    width = <128>;
    height = <32>;
    segment-offset = <0>;
    page-offset = <0>;
    display-offset = <0>;
    multiplex-ratio = <31>;
    segment-remap;
    com-invdir;
    com-sequential;
    prechargep = <0x22>;

    /* THE POLARITY FIX.
     * Stock ZMK sets `inversion-on`, which flips the panel so that a 0 in
     * the framebuffer lights the pixel. That is what gave you a lit
     * background with a dark trooper. Deleting it restores normal
     * polarity: background OFF (black), artwork ON (blue).
     *
     * If after flashing it is inverted the OTHER way, comment out the
     * delete-property line below and add `inversion-on;` instead.
     */
    /delete-property/ inversion-on;
};

/* ------------------------------------------------------------------ */
/* OPTION B - 0.96" 128x64 SSD1306                                     */
/* Uncomment this whole block AND comment out Option A.                */
/* Note: `com-sequential` must be REMOVED for 64-row panels.           */
/* ------------------------------------------------------------------ */
/*
&oled {
    compatible = "solomon,ssd1306fb";
    width = <128>;
    height = <64>;
    segment-offset = <0>;
    page-offset = <0>;
    display-offset = <0>;
    multiplex-ratio = <63>;
    segment-remap;
    com-invdir;
    /delete-property/ com-sequential;
    /delete-property/ inversion-on;
    prechargep = <0x22>;
};
*/

/* ------------------------------------------------------------------ */
/* OPTION C - 1.3" SH1106 / SH1107                                     */
/* An SH1106 driven by the SSD1306 driver is a classic "whole panel    */
/* lights up" failure: the SH1106 ignores SSD1306's page-addressing    */
/* command, so the framebuffer never lands where you think it does.    */
/* ------------------------------------------------------------------ */
/*
&pro_micro_i2c {
    status = "okay";

    oled: sh1106@3c {
        compatible = "sinowealth,sh1106";
        reg = <0x3c>;
        width = <128>;
        height = <64>;
        segment-offset = <2>;   // SH1106 has 132 columns; 2-column offset
        page-offset = <0>;
        display-offset = <0>;
        multiplex-ratio = <63>;
        segment-remap;
        com-invdir;
        prechargep = <0x22>;
    };
};
*/
