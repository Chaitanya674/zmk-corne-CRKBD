/*
 * LEFT HALF — 0.91" 128x32 SSD1306
 *
 * Both your panels are the same physical module (confirmed from photos:
 * identical narrow strip shape, identical GND/VCC/SCK/SDA pinout). The
 * "1.3" and "1.6" markings on the backs are PCB batch/revision numbers,
 * not screen sizes — there is no 128x64 panel on this board. The previous
 * version of this file wrongly declared this half as a 1.3" SH1106 at
 * 128x64. Feeding an SH1106 init sequence to an actual SSD1306 controller
 * means it never receives a command it understands, so the panel never
 * initializes — which reads as a totally dark screen. That is almost
 * certainly why the left half went from "wrong colors" to "nothing".
 *
 * This file is now identical to corne_right.overlay. Stock geometry,
 * only polarity changed.
 */

&oled {
    compatible = "solomon,ssd1306fb";
    reg = <0x3c>;
    width = <128>;
    height = <32>;
    segment-offset = <0>;
    page-offset = <0>;
    display-offset = <0>;
    multiplex-ratio = <31>;
    segment-remap;
    com-invdir;
    com-sequential;
    prechargep = <0x22>;

    /* Normal polarity: 0 = dark, 1 = lit. If the image still comes out
     * as a lit background with a dark shape, delete the line below and
     * write `inversion-on;` instead. */
    /delete-property/ inversion-on;
};
